## config/west.yml
```yaml
manifest:
  remotes:
    - name: tabbeber
      url-base: https://github.com/tabbeber
  projects:
    - name: zmk
      remote: tabbeber
      revision: test
      import: app/west.yml
  self:
    path: config
```
